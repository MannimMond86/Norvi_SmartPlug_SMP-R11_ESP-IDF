## components/ADE9153/Kconfig
```kconfig
menu "ADE9153 Settings"

    config IS_ACTIVATED_ADE9153
        bool "Enable ADE9153 Settings"
        default n

    if IS_ACTIVATED_ADE9153

    config CUSTOM_ADE9153_TX_PIN
        int "Set ADE9153 TX Pin"
        range 0 36
        default 16
        help
            This option defines the pin of the tx from the ADE9153 sensor.

    config CUSTOM_ADE9153_RX_PIN
        int "Set ADE9153 RX Pin"
        range 0 36
        default 17
        help
            This option defines the pin of the rx from the ADE9153 sensor.

    endif # IMPLEMENT_FEATURE

endmenu
```

## components/common_variable_handler/Kconfig
```kconfig
menu "Global Variable Settings"

    config IS_ACTIVATED_GLOBAL_VARIABLES
        bool "Enable global variables settings"
        default y

    if IS_ACTIVATED_GLOBAL_VARIABLES

    config GVS_PROJECT_VERSION
        prompt "Project Version"
        string
        default "1.0.0"
        help
            Specify the version of the global variables.

    endif # IS_ACTIVATED_GLOBAL_VARIABLES

endmenu
```

## components/common_variable_handler/Kconfig.CVH
```kconfig
menu "Global Variable Settings"

    config GVS_PROJECT_VERSION
        prompt "Project Version"
        string
        default "1.0.0"
        help
            Specify the version of the global variables.

endmenu
```

## components/display/Kconfig
```kconfig
menu "Display Settings"

    config IS_ACTIVATED_DISPLAY
        bool "Enable display settings"
        default n

    if IS_ACTIVATED_DISPLAY

    config DISPLAY_PROJECT_VERSION
        prompt "Project Version"
        string
        default "1.0.0"
        help
            Specify the version of the display project.

    config CUSTOM_DISPLAY_SDA_PIN
        prompt "Set Display SDA Pin"
        int
        range 0 36
        default 21
        help
            This option defines the SDA pin from the display.

    config CUSTOM_DISPLAY_SCL_PIN
        prompt "Set Display SCL Pin"
        int
        range 0 36
        default 22
        help
            This option defines the SCL pin from the display.

    endif # IS_ACTIVATED_DISPLAY

endmenu
```

## components/display/Kconfig.DISPLAY
```kconfig
menu "Display Settings"

    config DISPLAY_PROJECT_VERSION
        prompt "Project Version"
        string
        default "1.0.0"
        help
            Specify the version of the display project.

    config CUSTOM_DISPLAY_SDA_PIN
        prompt "Set Display SDA Pin"
        int
        range 0 36
        default 21
        help
            This option defines the SDA pin from the display.

    config CUSTOM_DISPLAY_SCL_PIN
        prompt "Set Display SCL Pin"
        int
        range 0 36
        default 22
        help
            This option defines the SCL pin from the display.

endmenu
```

## components/electricity_relay/Kconfig
```kconfig
menu "Electricity Relay"

    config IS_ACTIVATED_RELAY
        bool "Enable Relay Settings"
        default n

    if IS_ACTIVATED_RELAY

    config RELAY_PROJECT_VERSION
        prompt "Project Version"
        string
        default "1.0.0"
        help
            Specify the version of the display project.

    config CUSTOM_RELAY_PIN
        prompt "Set Electricity Relay Pin"
        int
        range 0 36
        default 12
        help
            This option defines the SDA pin from the display.

    endif # IS_ACTIVATED_RELAY

endmenu
```

## components/fatfs_storage/Kconfig
```kconfig
menu "FATFS Settings"
    # This option controls whether the feature is enabled
    config ENABLE_NVS_SETTINGS
        bool "Enable FATFS Settings"
        default y
        help
          Enable this option to include SSID & Password in the build.

endmenu
```

## components/modem_interface/Kconfig
```kconfig
menu"Modem Settings"
    config MODEM_PROJECT_VERSION
        prompt "Project Version"
        string
        default "1.0.0"
        help
            Specify the version of the Modem project.

    choice MODEM_TYPE
        prompt "Modem Select Option"
        default MODEM_TARGET_QUECTEL_BC28JB
        help
            Nothing yet

        config MODEM_TARGET_QUECTEL_BC28JB
            prompt "QUECTEL BC28JB"
            bool

        config MODEM_TARGET_QUECTEL_BC28JA
            prompt "QUECTEL BC28JB"
            bool

        config MODEM_TARGET_SIMCOM_SIM7000G
             prompt "SIM7000G"
             bool
             help
                 not implemented yet. coming soon!

        config MODEM_TARGET_SIMCOM_SIM800G
             prompt "SIM800G"
             bool
             help
                 not implemented yet. coming soon!

    endchoice # MODEM_TYPE

    config ACCESS_POINT_NAME
        prompt "APN: mobile Network Gateway"
        string
        default "wsim"
        help
            An APN (Access Point Name) is a gateway between a mobile network (like GSM, GPRS, 3G, 4G, or 5G) and another network, often the public internet. It's a set of configurations that allow a device to connect to a specific network operator and access the internet

    config CUSTOM_BC28_RX_PIN
        prompt "Set RX Pin"
        int
        range 0 36
        default 14
        help
            This option defines the rx pin of the modem.

    config CUSTOM_BC28_TX_PIN
        prompt "Set TX Pin"
        int
        range 0 36
        default 15
        help
            This option defines the tx pin of the modem.

    config CUSTOM_BC28_RESET_PIN
        prompt "Set RESET Pin"
        int
        range 0 36
        default 19
        help
            This option defines the reset pin of the modem.

    config CUSTOM_BC28_ENABLE_PIN
        prompt "Set ENABLE Pin"
        int
        range 0 36
        default 18
        help
            This option defines the tx pin of the modem.

endmenu
```

## components/modem_interface/Kconfig.MODEM_INTERFACE
```kconfig
menu"Modem Settings"

    choice MODEM_TYPE
        prompt "Modem Select Option"
        default MODEM_TARGET_QUECTEL_BC28JB
        help
            Nothing yet

        config MODEM_TARGET_QUECTEL_BC28JB
            bool
            prompt "QUECTEL BC28JB"


        config MODEM_TARGET_QUECTEL_BC28JA
            bool
            prompt "QUECTEL BC28JB"

        config MODEM_TARGET_SIMCOM_SIM7000G
             bool
             prompt "SIM7000G"
             help
                 not implemented yet. coming soon!

        config MODEM_TARGET_SIMCOM_SIM800G
             bool
             prompt "SIM800G"
             help
                 not implemented yet. coming soon!

    endchoice # MODEM_TYPE

    config MODEM_PROJECT_VERSION
        prompt "Modem Project Version Prompt"
        string "Project Version String"
        default "1.0.0"
        help
            Specify the version of the Modem project.

endmenu
```

## components/mqtt_interface/Kconfig
```kconfig
menu "MQTT Settings"

    config IS_ACTIVATED_MQTT
        bool "Enable MQTT Settings"
        default y

    if IS_ACTIVATED_MQTT

    config MQTT_PROJECT_VERSION
        prompt "Project Version"
        string
        default "1.0.0"
        help
            Specify the version of the ADE9153 project.

    endif # IS_ACTIVATED_MQTT

endmenu
```

## components/nvs_storage/Kconfig
```kconfig
menu "NVS Settings"
    # This option controls whether the feature is enabled
    config ENABLE_NVS_SETTINGS
        bool "Enable NVS Settings"
        default y
        help
          Enable this option to include SSID & Password in the build.

endmenu
```

## components/thingsboard_interface/Kconfig
```kconfig
menu "Thingsboard Settings"

    config IS_ACTIVATED_THINGSBOARD
        bool "Enable Thingsboard Settings"
        default y

    if IS_ACTIVATED_THINGSBOARD

    config THINGSBOARD_PROJECT_VERSION
        prompt "Project Version"
        string
        default "1.0.0"
        help
            Specify the version of the thingsboard project.

    endif # IS_ACTIVATED_THINGSBOARD

endmenu
```

## components/thingsboard_interface/Kconfig.THINGSBOARD_INTERFACE
```kconfig
menu "Thingsboard Settings"
    config THINGSBOARD_PROJECT_VERSION
        string "Project Version"
        default "1.0.0"
        help
            Specify the version of the thingsboard project.
endmenu
```

## components/time_manager/Kconfig
```kconfig
menu "Time Schedular Settings"

    config IS_ACTIVATED_TIME_SCHEDULAR
        bool "Enable Touch Button Settings"
        default n

    if IS_ACTIVATED_TIME_SCHEDULAR

    config TIME_SCHEDULAR_PROJECT_VERSION
        prompt "Project Version"
        string
        default "1.0.0"
        help
            Specify the version of the Touch Button project.

    endif # TOUCH_BUTTON

endmenu
```

## components/touch_button/Kconfig
```kconfig
menu "Touch Button Settings"

    config IS_ACTIVATED_TOUCH_BUTTON
        bool "Enable Touch Button Settings"
        default n

    if IS_ACTIVATED_TOUCH_BUTTON

    config TOUCH_BUTTON_PROJECT_VERSION
        prompt "Project Version"
        string
        default "1.0.0"
        help
            Specify the version of the Touch Button project.

    config CUSTOM_TOUCH_BUTTON_PIN
        prompt "Set Touch Button Pin"
        int
        range 0 36
        default 13
        help
            This option defines the pin of the touch button.

    endif # TOUCH_BUTTON

endmenu
```

## components/touch_button/Kconfig.TOUCH_BUTTON
```kconfig
menu "Touch Button Settings"

    config TOUCH_BUTTON_PROJECT_VERSION
        prompt "Project Version"
        string
        default "1.0.0"
        help
            Specify the version of the Touch Button project.

    config CUSTOM_TOUCH_BUTTON_PIN
        prompt "Set Touch Button Pin"
        int
        range 0 36
        default 13
        help
            This option defines the pin of the touch button.

endmenu
```

## components/uart_forwarder/Kconfig
```kconfig
menu "UART Forwarder Settings"

    config IS_ACTIVATED_UART
        bool "Enable UART-Forwarder Settings"
        default y

    if IS_ACTIVATED_UART

    config UART_PROJECT_VERSION
        prompt "Project Version"
        string
        default "1.0.0"
        help
            Specify the version of the UART forwarder project.

    endif # IS_ACTIVATED_UART

endmenu
```

## components/wifi_handler/Kconfig
```kconfig
menu "WiFi Settings"
    # This option controls whether the feature is enabled
    config ENABLE_WIFI_SETTINGS
        bool "Enable WiFi Settings"
        default y
        help
          Enable this option to include SSID & Password in the build.

    config WIFI_ACTIVATED
        int "WiFi is Enabled"
        range 0 1
        default 1 if ENABLE_WIFI_SETTINGS
        default 0 if !ENABLE_WIFI_SETTINGS
        help
          This variable indicates whether WiFi is enabled. It is set to true if ENABLE_WIFI is enabled, and false if not.

    config WIFI_SSID
        string "WiFi SSID"
        default "POSTV-Fritzbox" if ENABLE_WIFI_SETTINGS
        default "" if !ENABLE_WIFI_SETTINGS
        help
            SSID (network name) for the example to connect to.

    config WIFI_PASSWORD
        string "WiFi Password"
        default "postvadm1n" if ENABLE_WIFI_SETTINGS
        default "" if !ENABLE_WIFI_SETTINGS
        help
            WiFi password (WPA or WPA2) for the example to use.

endmenu
```

## main/Kconfig.projbuild
```kconfig
# Kconfig.projbuild
menu "SmartPlug Configurations"

    config SMART_PLUG_PROJECT_VERSION
        string "Project Version"
        default "1.0.0"
        help
            Specify the version of your project.

    rsource "../components/ADE9153/Kconfig"
    rsource "../components/common_variable_handler/Kconfig"
    rsource "../components/display_ssd1306/Kconfig"
    rsource "../components/electricity_relay/Kconfig"
    rsource "../components/fatfs_storage/Kconfig"
    rsource "../components/modem_interface/Kconfig"
    rsource "../components/mqtt_interface/Kconfig"
    rsource "../components/nvs_storage/Kconfig"
    rsource "../components/ThingsBoard/Kconfig"
    rsource "../components/time_manager/Kconfig"
    rsource "../components/touch_button/Kconfig"
    rsource "../components/uart_forwarder/Kconfig"
    rsource "../components/wifi_handler/Kconfig"

endmenu
```
